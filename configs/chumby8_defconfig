## configs/chumby8_defconfig
```kconfig
BR2_arm=y
BR2_GLOBAL_PATCH_DIR="board/chumby/chumby8/patches"
BR2_SSP_REGULAR=y
BR2_TOOLCHAIN_EXTERNAL=y
BR2_TOOLCHAIN_EXTERNAL_BOOTLIN=y
BR2_TOOLCHAIN_EXTERNAL_BOOTLIN_ARMV5_EABI_GLIBC_STABLE=y
BR2_ROOTFS_DEVICE_CREATION_DYNAMIC_EUDEV=y
# BR2_TARGET_GENERIC_REMOUNT_ROOTFS_RW is not set
BR2_ROOTFS_OVERLAY="board/chumby/chumby8/rootfs-overlay"
BR2_ROOTFS_POST_BUILD_SCRIPT="board/chumby/chumby8/post-build.sh"
BR2_ROOTFS_POST_IMAGE_SCRIPT="board/chumby/chumby8/post-image.sh"
BR2_LINUX_KERNEL=y
BR2_LINUX_KERNEL_CUSTOM_TARBALL=y
BR2_LINUX_KERNEL_CUSTOM_TARBALL_LOCATION="$(call github,dougg3,silvermoon-linux,f7cccf613f2d123623b86d99aba8eabf47faf5bc)/linux-f7cccf613f2d123623b86d99aba8eabf47faf5bc.tar.gz"
BR2_LINUX_KERNEL_USE_CUSTOM_CONFIG=y
BR2_LINUX_KERNEL_CUSTOM_CONFIG_FILE="board/chumby/chumby8/linux.config"
BR2_LINUX_KERNEL_UIMAGE=y
BR2_LINUX_KERNEL_UIMAGE_LOADADDR="0x8000"
BR2_LINUX_KERNEL_DTS_SUPPORT=y
BR2_LINUX_KERNEL_CUSTOM_DTS_PATH="board/chumby/chumby8/pxa168-chumby8.dts"
BR2_LINUX_KERNEL_INSTALL_TARGET=y
BR2_PACKAGE_BUSYBOX_SHOW_OTHERS=y
BR2_PACKAGE_ALSA_UTILS=y
BR2_PACKAGE_ALSA_UTILS_AMIXER=y
BR2_PACKAGE_ALSA_UTILS_APLAY=y
BR2_PACKAGE_MPV=y
BR2_PACKAGE_STRACE=y
BR2_PACKAGE_E2FSPROGS=y
BR2_PACKAGE_DEJAVU=y
BR2_PACKAGE_LIBERATION=y
BR2_PACKAGE_QT5=y
BR2_PACKAGE_QT5BASE_GUI=y
BR2_PACKAGE_QT5BASE_WIDGETS=y
BR2_PACKAGE_QT5BASE_XCB=y
BR2_PACKAGE_QT5BASE_DEFAULT_QPA="xcb"
BR2_PACKAGE_QT5BASE_FONTCONFIG=y
BR2_PACKAGE_XORG7=y
BR2_PACKAGE_XSERVER_XORG_SERVER=y
BR2_PACKAGE_XLIB_LIBXV=y
BR2_PACKAGE_XDRIVER_XF86_INPUT_LIBINPUT=y
BR2_PACKAGE_XDRIVER_XF86_VIDEO_ARMADA=y
BR2_PACKAGE_FLUXBOX=y
BR2_PACKAGE_CHUMBY_FIRMWARE=y
BR2_PACKAGE_CHUMBY_FIRMWARE_C8_OBM_BIN=y
BR2_PACKAGE_LINUX_FIRMWARE=y
BR2_PACKAGE_LINUX_FIRMWARE_LIBERTAS_SD8686_V9=y
BR2_PACKAGE_CHUMBY_UTILS=y
BR2_PACKAGE_EVTEST=y
BR2_PACKAGE_SPI_TOOLS=y
BR2_PACKAGE_CHUMBY_CPI=y
BR2_PACKAGE_CHUMBY_CPI_C8_BIN=y
BR2_PACKAGE_LIBDRI2=y
BR2_PACKAGE_LIBDRM_INSTALL_TESTS=y
BR2_PACKAGE_LIBGPIOD_TOOLS=y
BR2_PACKAGE_READLINE=y
BR2_PACKAGE_HAVEGED=y
BR2_PACKAGE_DROPBEAR=y
BR2_PACKAGE_DROPBEAR_DISABLE_REVERSEDNS=y
BR2_PACKAGE_IW=y
BR2_PACKAGE_NETWORK_MANAGER=y
BR2_PACKAGE_NTP=y
BR2_PACKAGE_NTP_NTPQ=y
BR2_PACKAGE_WIRELESS_REGDB=y
BR2_PACKAGE_WPA_SUPPLICANT=y
BR2_PACKAGE_WPA_SUPPLICANT_DEBUG_SYSLOG=y
BR2_PACKAGE_WPA_SUPPLICANT_CLI=y
BR2_PACKAGE_WPA_SUPPLICANT_DBUS=y
BR2_PACKAGE_UTIL_LINUX_RFKILL=y
BR2_PACKAGE_LESS=y
BR2_TARGET_ROOTFS_EXT2=y
BR2_TARGET_ROOTFS_EXT2_4=y
BR2_TARGET_ROOTFS_EXT2_SIZE="200M"
BR2_TARGET_ROOTFS_EXT2_MKFS_OPTIONS="-O ^64bit,^metadata_csum"
BR2_TARGET_UBOOT=y
BR2_TARGET_UBOOT_BUILD_SYSTEM_KCONFIG=y
BR2_TARGET_UBOOT_CUSTOM_TARBALL=y
BR2_TARGET_UBOOT_CUSTOM_TARBALL_LOCATION="$(call github,dougg3,u-boot,cdd588d7ee4bed6f0cec80f79eea570ad662c583)/uboot-cdd588d7ee4bed6f0cec80f79eea570ad662c583.tar.gz"
BR2_TARGET_UBOOT_BOARD_DEFCONFIG="chumby8"
BR2_PACKAGE_HOST_GENEXT2FS=y
BR2_PACKAGE_HOST_GENIMAGE=y
```

## package/chumby-cpi/Config.in
```kconfig
config BR2_PACKAGE_CHUMBY_CPI
	bool "chumby-cpi"
	depends on BR2_arm
	help
	  Cryptoprocessor interface program for Chumby

	  Pre-compiled binary of cpi for Chumby

	  https://github.com/sutajiokousagi/cpi

if BR2_PACKAGE_CHUMBY_CPI

config BR2_PACKAGE_CHUMBY_CPI_C8_BIN
	bool "chumby 8 cpi"
	help
	  Pre-compiled binary of cpi for Chumby 8 (silvermoon).

endif
```

## package/chumby-firmware/Config.in
```kconfig
config BR2_PACKAGE_CHUMBY_FIRMWARE
	bool "chumby-firmware"
	depends on BR2_arm
	help
	  Chumby Firmware

	  Pre-compiled binary of the first-stage bootloader

	  https://github.com/sutajiokousagi/meta-chumby

if BR2_PACKAGE_CHUMBY_FIRMWARE

config BR2_PACKAGE_CHUMBY_FIRMWARE_C8_OBM_BIN
	bool "chumby 8 obm.bin"
	help
	  Bootloader binary for Chumby 8 (silvermoon).

endif
```

## package/chumby-utils/Config.in
```kconfig
config BR2_PACKAGE_CHUMBY_UTILS
	bool "chumby-utils"
	depends on BR2_arm
	select BR2_PACKAGE_LIBGPIOD
	help
	  Miscellaneous Chumby utilities

	  Currently only contains chumby_card_reader_daemon for
	  monitoring the card reader and connecting and disconnecting
	  it from USB.

	  https://github.com/dougg3/chumby-utils
```

## package/chumby8tscal/Config.in
```kconfig
config BR2_PACKAGE_CHUMBY8TSCAL
	bool "chumby8tscal"
	depends on BR2_PACKAGE_QT5
	select BR2_PACKAGE_QT5BASE_WIDGETS
	select BR2_PACKAGE_XLIB_LIBX11
	select BR2_PACKAGE_XLIB_LIBXI
	help
	  Touchscreen calibration program for Chumby 8

	  https://github.com/dougg3/Chumby8TSCal
```

## package/libdrm-armada/Config.in
```kconfig
config BR2_PACKAGE_LIBDRM_ARMADA
	bool "libdrm-armada"
	depends on BR2_TOOLCHAIN_HAS_THREADS
	select BR2_PACKAGE_LIBDRM
	help
	  Etnaviv libdrm buffer object management module

	  http://git.arm.linux.org.uk/cgit/libdrm-armada.git/
```

## package/x11r7/xdriver_xf86-video-armada/Config.in
```kconfig
config BR2_PACKAGE_XDRIVER_XF86_VIDEO_ARMADA
	bool "xf86-video-armada"
	select BR2_PACKAGE_LIBDRM_ARMADA
	help
	 Xorg driver for Etnaviv GPU.

	 http://git.arm.linux.org.uk/cgit/xf86-video-armada.git
```
